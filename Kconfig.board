## Kconfig.board
```kconfig
# STM32L432KC Seraph board configuration

# Copyright (c) 2021 MATERIAM SAPI de CV
# SPDX-License-Identifier: Apache-2.0

config BOARD_SERAPH
	bool "SERAPH L432KC Development Board"
	depends on SOC_STM32L432XX
```

## Kconfig.defconfig
```kconfig
# STM32L432KC SERAPH board configuration

# Copyright (c) 2021 MATERIAM SAPI de CV
# SPDX-License-Identifier: Apache-2.0

if BOARD_SERAPH

config BOARD
	default "seraph"

config SPI_STM32_INTERRUPT
	default y
	depends on SPI

endif # BOARD_SERAPH
```

## board.yml
```yaml
board:
  name: seraph
  full_name: SERAPH L432KC
  vendor: materiam
  socs:
    - name: stm32l432xx
```

## seraph_defconfig
```kconfig
# SPDX-License-Identifier: Apache-2.0

CONFIG_SOC_SERIES_STM32L4X=y
CONFIG_SOC_STM32L432XX=y


# Enable MPU
CONFIG_ARM_MPU=y

# Enable HW stack protection
CONFIG_HW_STACK_PROTECTION=y

# enable uart driver
CONFIG_SERIAL=y

# enable pinmux
CONFIG_PINMUX=y

# enable GPIO
CONFIG_GPIO=y

# clock configuration
CONFIG_CLOCK_CONTROL=y



# Enable Clocks
CONFIG_CLOCK_CONTROL=y


# console
CONFIG_CONSOLE=y
CONFIG_UART_CONSOLE=y


CONFIG_LOG=y
CONFIG_LOG_DEFAULT_LEVEL=4

# enable pin controller
CONFIG_PINCTRL=y
```
